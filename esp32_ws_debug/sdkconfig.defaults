## esp32_ws_debug/sdkconfig.defaults
```kconfig
CONFIG_ESP_WIFI_ENABLED=y
CONFIG_ESP_NETIF_ENABLED=y
CONFIG_LWIP_ENABLED=y
CONFIG_ESP_EVENT_LOOP_ENABLED=y
CONFIG_ESP_WIFI_STATIC_RX_BUFFER_NUM=10
CONFIG_ESP_WIFI_DYNAMIC_RX_BUFFER_NUM=32
CONFIG_ESP_WIFI_DYNAMIC_TX_BUFFER_NUM=32
CONFIG_ESP_WIFI_AMPDU_TX_ENABLED=y
CONFIG_ESP_WIFI_AMPDU_RX_ENABLED=y
CONFIG_ESP_WIFI_NVS_ENABLED=y
CONFIG_LWIP_MAX_SOCKETS=16
CONFIG_LWIP_SO_REUSE=y
CONFIG_LWIP_SO_RCVBUF=y
CONFIG_LWIP_TCP_SND_BUF_DEFAULT=5760
CONFIG_LWIP_TCP_WND_DEFAULT=5760
```

## main/Kconfig.projbuild
```kconfig
menu "WiFi Configuration"

    config ESP_WIFI_SSID
        string "WiFi SSID"
        default "jhome"
        help
            SSID (network name) for the ESP32 to connect to.

    config ESP_WIFI_PASSWORD
        string "WiFi Password"
        default "123698745"
        help
            WiFi password (WPA or WPA2) for the ESP32 to use.

endmenu
```

## sdkconfig.defaults
```kconfig
# ESP32-WROVER-DEV Board Configuration
CONFIG_IDF_TARGET="esp32"
CONFIG_IDF_TARGET_ESP32=y

# Enable WiFi
CONFIG_ESP32_ENABLE_WIFI=y
CONFIG_ESP_WIFI_ENABLED=y
CONFIG_ESP_WIFI_NVS_ENABLED=y

# WiFi Configuration
CONFIG_ESP_WIFI_SSID="jhome"
CONFIG_ESP_WIFI_PASSWORD="123698745"

# Camera Configuration - OV2640 (esp32-camera component will handle this)

# PSRAM for dual framebuffer
CONFIG_ESP32_SPIRAM_SUPPORT=y
CONFIG_SPIRAM=y
CONFIG_SPIRAM_MODE_QUAD=n
CONFIG_SPIRAM_MODE_OCT=n
CONFIG_SPIRAM_USE_MEMMAP=n
CONFIG_SPIRAM_USE_CAPS_ALLOC=n
CONFIG_SPIRAM_USE_CHRONES_ALLOC=n
CONFIG_SPIRAM_SIZE="-1"
CONFIG_SPIRAM_HP_SIZE=0
CONFIG_SPIRAM_EXEC=y

# Framebuffer settings
CONFIG_CAMERA_FB_SZ_VGA=y

# HTTP Server (WebSocket not needed for control)
CONFIG_ESP_HTTPD_WS_SUPPORT=n

# Disable unused features to save memory
CONFIG_FREERTOS_HZ=1000
CONFIG_ESPTOOLPY_FLASHFREQ_80M=y
CONFIG_ESPTOOLPY_FLASHMODE_QIO=y
CONFIG_ESPTOOLPY_FLASHSIZE_4MB=y
CONFIG_PARTITION_TABLE_SINGLE_APP=y

# Disable BT
CONFIG_ESP32_ENABLE_BT=n
CONFIG_ESP32_WIFI_SW_COEXIST_ENABLE=n
```
